// SPDX-License-Identifier: GPL-2.0+
/**
 * Devicetree file with the public key EFI Signature List(ESL)
 * node. This file is used to generate the dtsi file to be
 * included into the DTB.
*/
/ {
	signature {
		capsule-key = /incbin/("/media/drive_a/imx/work_dir/u-boot/uboot-calixto/uboot-imx/CRT.esl");
	};
};
