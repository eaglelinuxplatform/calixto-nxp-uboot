## board/calixto/imx6ull_tiny/Kconfig
```kconfig
if TARGET_IMX6ULL_TINY

config SYS_BOARD
	default "imx6ull_tiny"

config SYS_VENDOR
	default "calixto"

config SYS_CONFIG_NAME
	default "imx6ull_tiny"

config IMX_CONFIG
	default "board/calixto/imx6ull_tiny/imximage_ddr3_256.cfg"

config SYS_TEXT_BASE
	default 0x87800000
endif
```

## board/calixto/imx6ull_versa/Kconfig
```kconfig
if TARGET_IMX6ULL_VERSA

config SYS_BOARD
	default "imx6ull_versa"

config SYS_VENDOR
	default "calixto"

config SYS_CONFIG_NAME
	default "imx6ull_versa"

config IMX_CONFIG
	default "board/calixto/imx6ull_tiny/imximage_ddr3_256.cfg"

config TEXT_BASE
	default 0x87800000
endif
```

## board/calixto/imx8mp_optima/Kconfig
```kconfig
if TARGET_IMX8MP_OPTIMA 

config SYS_BOARD
	default "imx8mp_optima"

config SYS_VENDOR
	default "calixto"

config SYS_CONFIG_NAME
	default "imx8mp_optima"

config IMX8MP_LPDDR4_2GB
	bool "Using LPDDR4 2GB RAM"
	

config IMX8MP_LPDDR4_4GB
	bool "Using LPDDR4 4GB RAM"
	
	
config IMX_CONFIG
	default "board/calixto/imx8mp_optima/imximage-8mp-lpddr4.cfg"

config IMX8MP_GP5_LOCK_UPDATE
	bool "Enable burn GP5_LOCK fuse at boot"
	help
	  Select to check the GP5_LOCK fuse and burn it to WP+OP

endif
```

## board/calixto/imx93_versa/Kconfig
```kconfig
if TARGET_IMX93_VERSA

config SYS_BOARD
	default "imx93_versa"

config SYS_VENDOR
	default "calixto"

config SYS_CONFIG_NAME
	default "imx93_versa"

config IMX93_LPDDR4X_1GB
	bool "Using LPDDR4X 1GB RAM"
	default n
	select IMX9_LPDDR4X
	help
	  Select the LPDDR4X 1GB timing and 0.6V VDDQ

config IMX93_LPDDR4X_2GB
        bool "Using LPDDR4X 2GB RAM"
        default n
        select IMX9_LPDDR4X
        help
          Select the LPDDR4X 2GB timing and 0.6V VDDQ



endif
```
